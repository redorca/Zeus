## nuttx/configs/zglue_zeus1_remora_board/Kconfig
```kconfig
#
# For a description of the syntax of this configuration file,
# see the file kconfig-language.txt in the NuttX tools repository.
#

config ARCH_HAVE_FAST
	bool "Enable zglue Zeus platform"
	default y
	---help---
		Enable Zglue (First generation) Architecture

config ARCH_HAVE_JTAG
	bool "Enable zglue Zeus JTAG"
	default y
	---help---
		Enable Zglue (First generation) Architecture

config CODE_ANALYSIS
  bool "code size analysis"
  default n
  ---help---
    This is for analysis each module code size and data size
```

## nuttx/configs/zglue_zeus2_chicago_MPW_LGA_V2/Kconfig
```kconfig
#
# For a description of the syntax of this configuration file,
# see the file kconfig-language.txt in the NuttX tools repository.
#

config ARCH_HAVE_FAST
	bool "Enable zglue Zeus platform"
	default y
	---help---
		Enable Zglue zeus Architecture

config CODE_ANALYSIS
  bool "code size analysis"
  default y
  ---help---
    This is for analysis each module code size and data size
```

## nuttx/drivers/gpio_api/Kconfig
```kconfig
#
# For a description of the syntax of this configuration file,
# see the file kconfig-language.txt in the NuttX tools repository.
#


config     ARCH_VIRTUAL_GPIO
           bool "gpio driver lib"
           default n
           ---help---
                An internal gpio interface backed by chip code
                that provides a general way for others to use
                across mcus

if ARCH_VIRTUAL_GPIO

config     TARGET_DRIVER
           string
           default "gpio_api"
           ---help---
                Specifies the driver involved.
endif
```
