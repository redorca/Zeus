## nuttx/drivers/sensors/Kconfig
```kconfig
#
# For a description of the syntax of this configuration file,
# see the file kconfig-language.txt in the NuttX tools repository.
#
config MC3672
	bool "MC3672 3-Axis Accelerometer"
	default n
	---help---
		Enable driver support for the MC3672 3-Axis Accelerometer.

if MC3672

choice
	prompt "MC3672 interface"
	default MC3672_INTF_I2C

config MC3672_INTF_I2C
	bool "I2C"
	select I2C
	---help---
		use I2C bus to access MC3672

config MC3672_INTF_SPI
	bool "SPI"
	select SPI
	---help---
		use SPI bus to access MC3672

endchoice

config MC3672_I2C_SPEED
	int "MC3672 I2C interface speed"
	default 400000
	range 1000 400000
	depends on MC3672_INTF_I2C

choice
    prompt "MC3672 I2C address"
    default MC3672_I2C_ADDR_0x10
    depends on MC3672_INTF_I2C

config MC3672_I2C_ADDR_0x4c
    bool "0x4c"

config MC3672_I2C_ADDR_0x6c
    bool "0x6c"

endchoice

choice
	prompt "MC3672 SPI Clock Frequency"
	default MC3672_SPI_4M
	depends on MC3672_INTF_SPI

config MC3672_SPI_125K
	bool "125K"
	---help---
		SPI clock frequency of 125KHz

config MC3672_SPI_250K
	bool "250K"
	---help---
		SPI clock frequency of 250KHz

config MC3672_SPI_500K
	bool "500K"
	---help---
		SPI clock frequency of 500KHz

config MC3672_SPI_1M
	bool "1M"
	---help---
		SPI clock frequency of 1M

config MC3672_SPI_2M
	bool "2M"
	---help---
		SPI clock frequency of 2M

config MC3672_SPI_4M
	bool "4M"
	---help---
		SPI clock frequency of 4M

config MC3672_SPI_8M
	bool "8M"
	---help---
		SPI clock frequency of 8M

endchoice

config MC3672_USE_INT
	bool "MC3672 use INT pin"
	default y
	---help---
		Use INT pin in read operation, if disable, you can only got 30 samples in maximum each time you do read system call.

endif # MC3672


config MAX86140
	bool "MAX86140 heart rate sensor"
	default n
	select SPI
	---help---
		Enable driver support for the MAX86140 heart rate sensor.

if MAX86140

choice
	prompt "MAX86140 SPI Clock Frequency"
	default MAX86140_4M

config MAX86140_125K
	bool "125K"
	---help---
		SPI clock frequency of 125KHz

config MAX86140_250K
	bool "250K"
	---help---
		SPI clock frequency of 250KHz

config MAX86140_500K
	bool "500K"
	---help---
		SPI clock frequency of 500KHz

config MAX86140_1M
	bool "1M"
	---help---
		SPI clock frequency of 1M

config MAX86140_2M
	bool "2M"
	---help---
		SPI clock frequency of 2M

config MAX86140_4M
	bool "4M"
	---help---
		SPI clock frequency of 4M

config MAX86140_8M
	bool "8M"
	---help---
		SPI clock frequency of 8M

endchoice

endif # MAX86140


config BMM150
	bool "BMM150 3-axis digital geomagnetic sensor"
	default n
	---help---
		Enable driver support for the BMM150 low power and low noise
                3-axis digital geomagnetic sensor.

if BMM150

config BMM150_FLOAT_ENABLE
	bool "BMM150 results in float formate"
	default n
	---help---
		Dispaly the BMM150 result in float formate, yes if you want float,no if you want int.

config BMM150_USE_DRDY
	bool "BMM150 use DRDY pin"
	default y
	---help---
		Use DRDY pin in read operation, if disable, you can only got one sample each time you do read system call.

choice
	prompt "BMM150 interface"
	default BMM150_INTF_I2C

config BMM150_INTF_I2C
	bool "I2C"
	select I2C
	---help---
		use I2C bus to access BMM150

config BMM150_INTF_SPI
	bool "SPI"
	select SPI
	---help---
		use SPI bus to access BMM150

endchoice

config BMM150_I2C_SPEED
	int "BMM150 I2C interface speed"
	default 400000
	range 1000 400000
	depends on BMM150_INTF_I2C

choice
    prompt "BMM150 I2C address"
    default BMM150_I2C_ADDR_0x10
    depends on BMM150_INTF_I2C

config BMM150_I2C_ADDR_0x10
    bool "0x10"

config BMM150_I2C_ADDR_0x11
    bool "0x11"

config BMM150_I2C_ADDR_0x12
    bool "0x12"

config BMM150_I2C_ADDR_0x13
    bool "0x13"

endchoice

choice
	prompt "BMM150 SPI Clock Frequency"
	default BMM150_SPI_4M
	depends on BMM150_INTF_SPI

config BMM150_SPI_125K
	bool "125K"
	---help---
		SPI clock frequency of 125KHz

config BMM150_SPI_250K
	bool "250K"
	---help---
		SPI clock frequency of 250KHz

config BMM150_SPI_500K
	bool "500K"
	---help---
		SPI clock frequency of 500KHz

config BMM150_SPI_1M
	bool "1M"
	---help---
		SPI clock frequency of 1M

config BMM150_SPI_2M
	bool "2M"
	---help---
		SPI clock frequency of 2M

config BMM150_SPI_4M
	bool "4M"
	---help---
		SPI clock frequency of 4M

config BMM150_SPI_8M
	bool "8M"
	---help---
		SPI clock frequency of 8M

endchoice

endif # BMM150

config BMI160
	bool "BMI160 6-axis inertial measurement units"
	default n
	---help---
		Enable driver support for the BMI160

if BMI160

choice
	prompt "BMI160 interface"
	default BMI160_INTF_I2C

config BMI160_INTF_I2C
	bool "I2C"
	select I2C
	---help---
		use I2C bus to access BMI160

config BMI160_INTF_SPI
	bool "SPI"
	select SPI
	---help---
		use SPI bus to access BMI160

endchoice

config BMI160_I2C_SPEED
	int "BMI160 I2C interface speed"
	default 400000
	range 1000 400000
	depends on BMI160_INTF_I2C

choice
    prompt "BMI160 I2C address"
    default BMI160_I2C_ADDR_0x68
    depends on BMI160_INTF_I2C

config BMI160_I2C_ADDR_0x68
    bool "0x68"

config BMI160_I2C_ADDR_0x69
    bool "0x69"

endchoice

choice
	prompt "BMI160 SPI Clock Frequency"
	default BMI160_SPI_4M
	depends on BMI160_INTF_SPI

config BMI160_SPI_125K
	bool "125K"
	---help---
		SPI clock frequency of 125KHz

config BMI160_SPI_250K
	bool "250K"
	---help---
		SPI clock frequency of 250KHz

config BMI160_SPI_500K
	bool "500K"
	---help---
		SPI clock frequency of 500KHz

config BMI160_SPI_1M
	bool "1M"
	---help---
		SPI clock frequency of 1M

config BMI160_SPI_2M
	bool "2M"
	---help---
		SPI clock frequency of 2M

config BMI160_SPI_4M
	bool "4M"
	---help---
		SPI clock frequency of 4M

config BMI160_SPI_8M
	bool "8M"
	---help---
		SPI clock frequency of 8M

endchoice

endif #BMI160

config LSM6DS3
	bool "LSM6DS3 6-axis iNEMO inertial measurement module"
	default n
	---help---
		Enable driver support for the LSM6DS3

if LSM6DS3

choice
	prompt "LSM6DS3 interface"
	default LSM6DS3_INTF_I2C

config LSM6DS3_INTF_I2C
	bool "I2C"
	select I2C
	---help---
		use I2C bus to access LSM6DS3

config LSM6DS3_INTF_SPI
	bool "SPI"
	select SPI
	---help---
		use SPI bus to access LSM6DS3

endchoice

config LSM6DS3_I2C_SPEED
	int "LSM6DS3 I2C interface speed"
	default 400000
	range 1000 400000
	depends on LSM6DS3_INTF_I2C

choice
    prompt "LSM6DS3 I2C address"
    default LSM6DS3_I2C_ADDR_0x6A
    depends on LSM6DS3_INTF_I2C

config LSM6DS3_I2C_ADDR_0x6A
    bool "0x6A"

config LSM6DS3_I2C_ADDR_0x6B
    bool "0x6B"

endchoice

choice
	prompt "LSM6DS3 SPI Clock Frequency"
	default LSM6DS3_SPI_4M
	depends on LSM6DS3_INTF_SPI

config LSM6DS3_SPI_125K
	bool "125K"
	---help---
		SPI clock frequency of 125KHz

config LSM6DS3_SPI_250K
	bool "250K"
	---help---
		SPI clock frequency of 250KHz

config LSM6DS3_SPI_500K
	bool "500K"
	---help---
		SPI clock frequency of 500KHz

config LSM6DS3_SPI_1M
	bool "1M"
	---help---
		SPI clock frequency of 1M

config LSM6DS3_SPI_2M
	bool "2M"
	---help---
		SPI clock frequency of 2M

config LSM6DS3_SPI_4M
	bool "4M"
	---help---
		SPI clock frequency of 4M

config LSM6DS3_SPI_8M
	bool "8M"
	---help---
		SPI clock frequency of 8M

endchoice

endif #LSM6DS3

config ICE40UP
	bool "iCE40 Ultra Plus family AI chip"
	default n
	---help---
		Enable driver support for the iCE40 AI chip

if ICE40UP

choice
    prompt "iCE40 result formate"
    default ICE40_RESULT_LEVEL
    depends on ICE40UP

config ICE40_RESULT_LEVEL
    bool "level"

config ICE40_RESULT_PWM
    bool "pwm"

endchoice
endif

config SENSORS_APDS9960
	bool "Avago APDS-9960 Gesture Sensor support"
	default n
	select I2C
	---help---
		Enable driver support for the Avago APDS-9960 gesture sensor.

config APDS9960_I2C_FREQUENCY
	int "APDS-9960 I2C frequency"
	default 400000
	depends on SENSORS_APDS9960

config SENSORS_AS5048B
	bool "AMS AS5048B Magnetic Rotary Encoder support"
	default n
	select I2C
	select SENSORS_QENCODER
	---help---
		Enable driver support for the AMS AS5048B magnetic rotary encoder.

config SENSORS_BH1750FVI
	bool "Rohm BH1750FVI Ambient Light Sensor support"
	default n
	select I2C
	---help---
		Enable driver support for the Rohm BH1750FVI light sensor.

config BH1750FVI_I2C_FREQUENCY
	int "BH1750FVI I2C frequency"
	default 400000
	depends on SENSORS_BH1750FVI

config SENSORS_BMG160
	bool "Bosch BMG160 Gyroscope Sensor support"
	default n
	select SPI
	---help---
		Enable driver support for the Bosch BMG160 gyroscope sensor.

config SENSORS_BMP180
	bool "Bosch BMP180 Barometer Sensor support"
	default n
	select I2C
	---help---
		Enable driver support for the Bosch BMP180 barometer sensor.

config SENSORS_HCSR04
	bool "HC-SR04 Distance Measurement Sensor"
	default n
	---help---
		Enable driver support for the HC-SR04 Distance Sensor.

if SENSORS_HCSR04

config HCSR04_DEBUG
        bool "Debug support for the HC-SR04"
        default n
        ---help---
                Enables debug features for the HC-SR04

config HCSR04_NPOLLWAITERS
        int "Number of waiters to poll"
        default 1
        ---help---
                Number of waiters to poll

endif # SENSORS_HCSR04

config SENSORS_HTS221
	bool "STMicro HTS221 humidity sensor"
	default n
	select I2C
	---help---
		Enable driver support for the STMicro HTS221 humidity sensor.

if SENSORS_HTS221

config HTS221_I2C_FREQUENCY
	int "HTS221 I2C frequency"
	default 400000
	range 1 400000

config HTS221_DEBUG
	bool "Debug support for the HTS221"
	default n
	---help---
		Enables debug features for the HTS221

config HTS221_NPOLLWAITERS
	int "Number of waiters to poll"
	default 1
	---help---
		Number of waiters to poll

endif # SENSORS_HTS221

config SENSORS_L3GD20
	bool "STMicro L3GD20 Gyroscope Sensor support"
	default n
	select SPI
	---help---
		Enable driver support for the STMicro L3GD20 gyroscope sensor.

config SENSOR_KXTJ9
	bool "Kionix KXTJ9 Accelerometer support"
	default n
	select I2C

if SENSORS_KXTJ9

config KXTJ9_I2C_BUS_SPEED
	int "Kionix KXTJ9 Bus Speed in Hz"
	default 400000

endif # SENSORS_KXTJ9

config SENSORS_LIS2DH
	bool "STMicro LIS2DH device support"
	default n
	select I2C
	---help---
		Enable driver support for the STMicro LIS2DH accelerometer

if SENSORS_LIS2DH

config LIS2DH_I2C_FREQUENCY
	int "LIS2DH I2C frequency"
	default 400000
	range 1 400000

config LIS2DH_DEBUG
	bool "Debug support for the LIS2DH"
	default n
	---help---
		Enables debug features for the LIS2DH

config LIS2DH_NPOLLWAITERS
	int "Number of waiters to poll"
	default 2
	---help---
		Maximum number of threads that can be waiting on poll()

config LIS2DH_DRIVER_SELFTEST
	bool "Enable selftest in LIS2DH driver"
	default n
	---help---
		Enable selftest in LIS2DH driver

endif # SENSORS_LIS2DH

config LIS3DSH
	bool "STMicro LIS3DSH 3-Axis accelerometer support"
	default n
	select SPI
	---help---
		Enable driver support for the STMicro LIS3DSH 3-Axis accelerometer.

config LIS3DH
	bool "STMicro LIS3DH 3-Axis accelerometer support"
	default n
	select SPI
	---help---
		Enable driver support for the STMicro LIS3DH 3-Axis accelerometer.

config LIS331DL
	bool "STMicro LIS331DL device support"
	default n
	select I2C

config LIS331DL_I2C_FREQUENCY
	int "LIS331DL I2C frequency"
	default 100000
	range 1 100000
	depends on LIS331DL

config SENSORS_LSM330SPI
	bool "STMicro LSM330 SPI support"
	default n
	select SPI
	---help---
		Enable driver support for the STMicro LSM330 on SPI.

config SENSORS_LSM9DS1
	bool "STMicro LSM9DS1 support"
	default n
	select I2C
	---help---
		Enable driver support for the STMicro LSM9DS1.

config LSM9DS1_I2C_FREQUENCY
	int "LSM9DS1 I2C frequency"
	default 400000
	range 1 400000
	depends on SN_LSM9DS1

config SENSORS_LPS25H
	bool "STMicro LPS25H pressure sensor"
	default n
	select I2C
	---help---
		Enable driver support for the STMicro LPS25H barometer sensor.

if SENSORS_LPS25H

config LPS25H_I2C_FREQUENCY
	int "LPS25H I2C frequency"
	default 400000
	range 1 400000

config DEBUG_LPS25H
	bool "Debug support for the LPS25H"
	default n
	---help---
		Enables debug features for the LPS25H

endif # SENSORS_LPS25H

config SENSORS_LTC4151
	bool "LTC4151 current and voltage monitor"
	default n
	select I2C
	---help---
		Enable driver support for the LinearTechnology LTC4151 current and voltage monitor.

config LTC4151_I2C_FREQUENCY
	int "LTC4151 I2C frequency"
	default 400000
	depends on SENSORS_LTC4151

config SENSORS_INA219
	bool "INA219 current and voltage monitor"
	default n
	select I2C
	---help---
		Enable driver support for the Texas Instruments INA219 current and voltage monitor.

config INA219_I2C_FREQUENCY
	int "INA219 I2C frequency"
	default 400000
	depends on SENSORS_INA219

config SENSORS_INA3221
	bool "INA3221 current and voltage monitor"
	default n
	select I2C
	---help---
		Enable driver support for the Texas Instruments INA3221 current and voltage monitor.

config INA3221_I2C_FREQUENCY
	int "INA3221 I2C frequency"
	default 400000
	depends on SENSORS_INA3221

config SENSORS_MB7040
	bool "MaxBotix MB7040 Sonar support"
	default n
	select I2C
	---help---
		Enable driver support for the MaxBotix MB7040 sonar.

config MB7040_I2C_FREQUENCY
	int "MB7040 I2C frequency"
	default 400000
	range 1 400000
	depends on SENSORS_MB7040

config SENSORS_MLX90393
	bool "MLX90393 3-Axis Magnetometer"
	default n
	select SPI
	---help---
		Enable driver support for the Melex MLX90393 3-Axis magnetometer.

config SENSORS_MCP9844
	bool "MCP9844 Temperature Sensor"
	default n
	select I2C
	---help---
		Enable driver support for the MCP9844 I2C Temperature sensor.

config MCP9844_I2C_FREQUENCY
	int "MCP9844 I2C frequency"
	default 400000
	range 1 400000
	depends on SENSORS_MCP9844

config SENSORS_MS58XX
	bool "MEAS MS58XX Altimeter support"
	default n
	select I2C
	---help---
		Enable driver support for MEAS MS58XX altimeters.

config MS58XX_I2C_FREQUENCY
	int "MS58XX I2C frequency"
	default 400000
	range 1 400000
	depends on SENSORS_MS58XX

config MS58XX_VDD
	int "MEAS MS58XX VDD"
	default 30
	depends on SENSORS_MS58XX

config SENSORS_MPL115A
	bool "Freescale MPL115A Barometer Sensor support"
	default n
	select SPI
	---help---
		Enable driver support for the Freescale MPL115A barometer sensor.

config MPL115A_REGDEBUG
	bool "Debug support for the MPL115A"
	default n
	depends on SENSORS_MPL115A
	---help---
		Enables register level debug features for the MPL115A

config SENSORS_ADXL345
	bool "Analog Devices ADXL345 Driver"
	default n
	---help---
		Enables support for the ADXL345 driver

if SENSORS_ADXL345

choice
	prompt "ADXL345 Interface"
	default ADXL345_SPI

config ADXL345_SPI
	bool "ADXL345 SPI Interface"
	select SPI
	---help---
		Enables support for the SPI interface.

config ADXL345_I2C
	bool "ADXL345 I2C Interface"
	select I2C
	---help---
		Enables support for the I2C interface

endchoice

config ADXL345_ACTIVELOW
	bool "Active Low Interrupt"
	default n
	---help---
		The ADXL345 interrupt will be inverted. Instead starting low and going
		high, it will start high and will go low when an interrupt is fired.
		Default:  Active high/rising edge.

config ADXL345_REGDEBUG
	bool "Enable Register-Level ADXL345 Debug"
	default n
	depends on DEBUG_FEATURES
	---help---
		Enable very low register-level debug output.

endif # SENSORS_ADXL345

config SENSORS_ADXL372
	bool "Analog Devices ADXL372 Sensor support"
	default n
	select SPI
	---help---
		Enable driver support for the Analog Devices ADXL372 Sensor.

config SENSORS_MAX44009
	bool "Maxim MAX44009 ALS sensor"
	default n
	select I2C
	---help---
		Enables MAX44009 Ambient Light Sensor

if SENSORS_MAX44009

config MAX44009_I2C_FREQUENCY
	int "MAX44009 I2C frequency"
	default 400000
	range 1 400000

config DEBUG_MAX44009
	bool "Enable debug support for the MAX44009"
	default n
	---help---
		Enables debug support for the MAX44009

config MAX44009_NPOLLWAITERS
	int "Number of waiters to poll"
	default 1
	---help---
		Number of waiters to poll

endif # SENSORS_MAX44009

config SENSORS_MAX31855
	bool "Maxim MAX31855 Driver"
	default n
	select SPI
	---help---
		Enables support for the MAX31855 driver

config SENSORS_MAX6675
	bool "Maxim MAX6675 Driver"
	default n
	select SPI
	---help---
		Enables support for the MAX6675 driver

config SENSORS_LIS3MDL
	bool "STMicro LIS3MDL 3-Axis magnetometer support"
	default n
	select SPI
	---help---
		Enable driver support for the STMicro LIS3MDL 3-axis magnetometer.

config LM75_I2C
	bool
	default y if LM75

config SENSORS_LM75
	bool "STMicro LM-75 Temperature Sensor support"
	default n
	select I2C
	select LM75_I2C
	---help---
		Enable driver support for the STMicro LM-75 temperature sensor.
		This should also work with compatible temperature sensors such as
		the TI TMP100/101.

config LM75_I2C_FREQUENCY
	int "LM75 I2C frequency"
	default 100000
	range 1 100000
	depends on LM75_I2C

config SENSORS_LM92
	bool "TI LM92 Temperature Sensor support"
	default n
	select I2C
	---help---
		Enable driver support for the TI LM92 Temperature Sensor.

config LM92_I2C_FREQUENCY
	int "LM92 I2C frequency"
	default 400000
	range 1 400000
	depends on LM92

config SENSORS_TMP108
	bool "TI TMP108 Temperature Sensor support"
	default n
	select I2C
	select TMP108_I2C
	---help---
		Enable driver support for the TI TMP108 temperature sensor.

config TMP108_I2C
	bool
	default y if TMP108

config TMP108_I2C_ADDR
	hex "TMP108 I2C address"
	default 0x48
	---help---
	        set TMP108 I2C address

config TMP108_I2C_FREQUENCY
	int "TMP108 I2C frequency"
	default 400000
	range 1 400000
	depends on TMP108_I2C


config QENCODER
	bool "Qencoder"
	default n

config QDECODER
	bool "Qdecoder"
	default n

config SENSORS_SHT21
	bool "Sensirion SHT21 temperature and humidity sensor"
	default n
	select I2C
	---help---
		Enable driver support for the Sensirion SHT20 and SHT21 temperature
		and humidity sensors. SHT20 is a budget model with limited humidity
		precision.

if SENSORS_SHT21

config SHT21_I2C_FREQUENCY
	int "SHT21 I2C frequency"
	default 400000
	range 1 400000

config SHT21_DEBUG
	bool "Debug support for the SHT21"
	default n
	---help---
		Enables debug features for the SHT21

endif # SENSORS_SHT21

config SENSORS_QENCODER
	bool "Qencoder"
	default n

config SENSORS_VEML6070
	bool "Vishay VEML6070 UV-A Light Sensor support"
	default n
	select I2C
	---help---
		Enable driver support for the Vishay VEML6070 UV-A light sensor.

config VEML6070_I2C_FREQUENCY
	int "VEML6070 I2C frequency"
	default 100000
	depends on SENSORS_VEML6070

config SENSORS_XEN1210
	bool "Sensixs XEN1210 Magnetometer"
	default n
	select SPI
	---help---
		Enable driver support for the Sensixs XEN1210 Magnetometer.

config XEN1210_REGDEBUG
	bool "Debug support for the XEN1210"
	default n
	depends on SENSORS_XEN1210
	---help---
		Enables register level debug features for the XEN1210

config SENSORS_ZEROCROSS
	bool "Zero Cross Sensor"
	default n
```
