## nuttx/drivers/zglue_fast/Kconfig
```kconfig
#
# For a description of the syntax of this configuration file,
# see the file kconfig-language.txt in the NuttX tools repository.
#


if ARCH_HAVE_FAST

choice
	prompt "zGlue Architecture selection"
	default ZEUS2
	depends on SYSTEM_FAST_DRIVER

config ZEUS1
	bool "ZEUS1"
	---help---
		Enable zGlue Zeus1 (First generation) Architecture

config ZEUS2
	bool "ZEUS2"
	---help---
		Enable zGlue Zeus2 (Second generation) Architecture

endchoice

config FAST_SPI
	bool "FAST SPI"
	depends on ZEUS2
	---help---
		Enable SPI interface to zGlue FAST Architecture

choice
	prompt "FAST SPI Clock Frequency"
	default FASTAPI_1MHZ
	depends on FAST_SPI

config FASTAPI_125KHZ
	bool "125KHz"
	---help---
		SPI clock frequency of 125KHz

config FASTAPI_250KHZ
	bool "250KHz"
	---help---
		SPI clock frequency of 250KHz

config FASTAPI_500KHZ
	bool "500KHz"
	---help---
		SPI clock frequency of 500KHz

config FASTAPI_1MHZ
	bool "1MHz"
	---help---
		SPI clock frequency of 1Mhz

config FASTAPI_2MHZ
	bool "2MHz"
	---help---
		SPI clock frequency of 2Mhz

config FASTAPI_4MHZ
	bool "4MHz"
	---help---
		SPI clock frequency of 4Mhz

config FASTAPI_8MHZ
	bool "8MHz"
	---help---
		SPI clock frequency of 8Mhz

endchoice

config FAST_I2C
	bool "FAST I2C"
	depends on ZEUS2
	---help---
		Enable I2C interface to zGlue FAST Architecture

config FAST_I2C_FREQUENCY
	int "FAST I2C frequency"
	default 400000
	range 1 400000
	depends on FAST_I2C

config FAST_JTAG
	bool "JTAG"
	depends on ZEUS1 || ZEUS2
	---help---
		Enable JTAG interface to zGlue Architecture. This is SW JTAG
		where 4 GPIO pins are bit banged to mimic the JTAG specification

config FAST_ULPM_WAKEUP_PIN
	bool "FAST ULPM wakeup pin"
	depends on ZEUS2
	---help---
		Enable ULPM wake pin

config FAST_FILE_DIRECTORY
	string "Fast sandbox"
	depends on SYSTEM_FAST_DRIVER
	default "/mnt"
	---help---
		Absolute pathes in received file names are not accepted.  This
		configuration value must be set to provide the path to the file
		storage directory (such as a mountpoint directory).

config FAST_CONFIG_FILE
	bool "Zglue FAST config file"
	depends on SYSTEM_FAST_DRIVER
	---help---
		Enable FAST configuration file to be stored in the FW flash.

config FLASH_FAST_CONFIG_FILE_LENGTH
	depends on ZEUS1 || ZEUS2
	depends on FAST_CONFIG_FILE
	hex	"Reserved size of FAST configuration file"
	default 0x1400

choice
	bool "zGlue FAST config file selection"
	default ZEUS2_CHICAGO
	depends on FAST_CONFIG_FILE

config ZEUS1_DALLAS
	depends on ZEUS1
	bool "Dallas"
	---help---
		Enable zGlue Zeus1 Dallas Architecture

config ZEUS1_AUSTIN
	depends on ZEUS1
	bool "Austin"
	---help---
		Enable zGlue Zeus1 Austin Architecture

config ZEUS2_CHICAGO
	depends on ZEUS2
	bool "chicago"
	---help---
		Enable zGlue Zeus2 chicago Architecture

config ZEUS2_CHICAGO_PP
	depends on ZEUS2
	bool "chicago_pp"
	---help---
		Enable zGlue Zeus2 chicago_pp Architecture

endchoice

config ZEUS2_DEVKIT_FEATURES
	bool "Enable zeus2 dev kit features"
	---help---
		Enable zGlue Zeus2 dev kit features
		Features include
		1) PWR clk rdy and fast rdy monitoring
		2) Access to fast_en_l and fast_en_h pins
		3) Monitor power config

endif #ARCH_HAVE_FAST
```

## nuttx/external/Kconfig
```kconfig
#
# For a description of the syntax of this configuration file,
# see the file kconfig-language.txt in the NuttX tools repository.
#

source external/mbedtls/Kconfig

source external/tinycrypt/Kconfig

source external/mcuboot/Kconfig

source external/nimble/Kconfig

source external/systemview/Kconfig

source external/lwip/Kconfig
```

## nuttx/external/lwip/Kconfig
```kconfig
#
# For a description of the syntax of this configuration file,
# see the file kconfig-language.txt in the NuttX tools repository.
#

menuconfig LWIP
	bool
	prompt "LWIP Support"
	default n
	help
	  This option enables the light weight ip stack.

if LWIP

config LWIP_NUTTX_OS
  bool "LWIP nuttx os supprot"
  default y
  help
  The nuttx os arch config for lwIP

config LWIP_CORE
  bool "LWIP core feature supprot"
  default y
  help
  The minimum set of files needed for lwIP

config LWIP_IP4
  bool "LWIP ipv4 feature supprot"
  default y
  depends on LWIP_CORE
  help
  LWIP ipv4 feature supprot

config LWIP_IP6
  bool "LWIP ipv6 feature supprot"
  default y
  depends on LWIP_CORE
  help
  LWIP ipv6 feature supprot

config LWIP_API
  bool "LWIP api feature supprot"
  default y
  depends on LWIP_CORE
  help
  The files which implement the sequential and socket APIs

config LWIP_NETIF
  bool "LWIP netif feature supprot"
  default y
  depends on LWIP_CORE
  help
  Files implementing various generic network interface functions


config LWIP_6LOWPAN
  bool "LWIP 6LoWPAN feature supprot"
  default y
  depends on LWIP_CORE
  help
  IP6 for low power personal area network.

config LWIP_PPP
  bool "LWIP PPP feature supprot"
  default n
  depends on LWIP_CORE
  help
  Point-to-point protocol.

config LWIP_SNMP
  bool "LWIP SNMP feature supprot"
  default n
  depends on LWIP_CORE
  help
  Simple Network Management Protocol.

config LWIP_HTTP
  bool "LWIP HTTP feature supprot"
  default n
  depends on LWIP_CORE
  help
  HTTP server + client.

endif # LWIP
```

## nuttx/external/mbedtls/Kconfig
```kconfig
#
# For a description of the syntax of this configuration file,
# see the file kconfig-language.txt in the NuttX tools repository.
#

menuconfig MBEDTLS
	bool
	prompt "mbedTLS Support"
	default n
	help
	  This option enables the mbedTLS cryptography library.

if MBEDTLS

choice
	prompt "Select implementation"
	default MBEDTLS_BUILTIN

config MBEDTLS_BUILTIN
	bool "Enable mbedTLS integrated sources"
	depends on MBEDTLS
	help
	Link with local mbedTLS sources instead of external library.

config MBEDTLS_LIBRARY
	bool "Enable mbedTLS external library"
	depends on MBEDTLS
	help
	This option enables mbedTLS library.

endchoice

config MBEDTLS_DEBUG
	string "mbed TLS debug activation"
	depends on MBEDTLS_BUILTIN
	default n
	help
	Enable debugging activation for mbed TLS configuration. Note that this
	does not directly cause any debug print output. For that you need to
	call
	mbedtls_debug_set_threshold(level);
	and
	mbedtls_ssl_conf_dbg(&mbedtls.conf, my_debug, NULL);
	functions in your application, and create the my_debug() function to
	actually print something useful.

config MBEDTLS_CFG_FILE
	string "mbed TLS customized file"
	default "config-nuttx.h"
	help
	the customized config file for mbedtls

config MBEDTLS_ENABLE_HEAP
	bool "Enable global heap for mbed TLS"
	default n
	depends on MBEDTLS
	help
	This option enables the mbedtls to use the heap. This setting must
	be global so that various applications and libraries in Zephyr do not
	try to do this themselves as there can be only one heap defined
	in mbedtls. If this is enabled, then the Zephyr will, during the device
	startup, initialize the heap automatically.

config MBEDTLS_HEAP_SIZE
	int "Heap size for mbed TLS"
	depends on MBEDTLS_ENABLE_HEAP
	help
	The mbedtls routines will use this heap if enabled.
	See ext/lib/crypto/mbedtls/include/mbedtls/config.h and
	MBEDTLS_MEMORY_BUFFER_ALLOC_C option for details. That option is not
	enabled by default.
	Default value for the heap size is not set as it depends on the
	application. For server application 15000 bytes should be enough.
	For some dedicated and specific usage of mbedtls API, the 1000 bytes
	might be ok.

endif
```

## nuttx/external/mcuboot/Kconfig
```kconfig
#
# For a description of the syntax of this configuration file,
# see the file kconfig-language.txt in the NuttX tools repository.
#

menuconfig MCUBOOT
	bool
	prompt "MCUBOOT Library Support"
	default n
	help
	  This option enables the mcuboot secure library.

if MCUBOOT

choice
  prompt "Select cryptography Library"
  default USE_MBED_TLS

config USE_MBED_TLS
  bool "use mbedtls as cryptography"
  select MBEDTLS
  help
  link mbedtls as cryptography library

config USE_TINYCRYPT
  bool "use tinycrypt as cryptography library"
  select TINYCRYPT
  help
  This option enable tinycrypt as cryptography library for mcuboot

endchoice

config MCUBOOT_APP_IMAGE_MAX_SIZE
  hex "The max size of application"
  default 0x40000
  help
  This is the MAX size of flash application

config MCUBOOT_APP_IMAGE_OFFSET
  hex "The offset of application in flash"
  default 0x10000
  help
  This is the application offset in flash memory

config MCUBOOT_APP_IMAGE_SCRATCH_SIZE
  hex "The image swap sector size , it should be one sector at least"
  default 0x2000
  help
  This is the scratch swap partition size, it should be one sector at least for swap

config MCUBOOT_FLASH_WRITE_ALIGN
  int "flash  write align size"
  default 4
  help
  This is the bootloader  for flash write align size

config MCUBOOT_VALIDATE_SLOT0
  bool "Signature verification on image"
  default y
  depends on MCUBOOT_SIGN_RSA || MCUBOOT_SIGN_EC || MCUBOOT_SIGN_EC256
  help
  This is the option for verfiy the image signature

choice
  prompt "Select the Second Image Location"
  default MCUBOOT_SECOND_IMAGE_INTERNAL

config MCUBOOT_SECOND_IMAGE_INTERNAL
  bool "Second image is located in internal flash"
  help
  Internal Flash as second image location

config MCUBOOT_SECOND_IMAGE_QSPI
  bool "Second image is location in QSPI flash"
  help
  QSPI Flash as second image location

endchoice

config MCUBOOT_SIGN_RSA
  bool "RSA signature"
  default y
  help
  This option enables the RSA crypto for signature

config MCUBOOT_SIGN_EC
  bool "EC signature"
  default n
  help
  THis option enable the EC crypto for signature

config MCUBOOT_SIGN_EC256
  bool "EC256 signature"
  default n
  help
  This option enable the EC256 crypto for signature

endif
```

## nuttx/external/nimble/Kconfig
```kconfig
#
# For a description of the syntax of this configuration file,
# see the file kconfig-language.txt in the NuttX tools repository.
#

menuconfig BLE_NIMBLE
	bool
	prompt "NIMBLE Library Support"
	default n
	help
	  This option enables the external nimble stack library.

if BLE_NIMBLE

config NIMBLE_SYS_1_BLOCK_SIZE
  int "nimble system 1 memory block size"
  default 128
  help
  nimble system 1 memory block size

config NIMBLE_SYS_1_BLOCK_COUNT
  int "nimble system 1 memory block count"
  default 32
  help
  nimble system 1 memory block count

config NIMBLE_SYS_2_BLOCK_SIZE
  int "nimble system 2 memory block size"
  default 0
  help
  nimble system 2 memory block size

config NIMBLE_SYS_2_BLOCK_COUNT
  int "nimble system 2 memory block count"
  default 0
  help
  nimble system 2 memory block count

menuconfig BLE_NIMBLE_HOST
	bool "Nimble host stack Support"
	default n

if BLE_NIMBLE_HOST
source external/nimble/host/Kconfig
endif

menuconfig BLE_NIMBLE_CONTROLLER
	bool "Nimble controller stack Support"
	default n

# current there is no option for controller , will add in further
#source external/nimble/controller/Kconfig

menuconfig BLE_NIMBLE_TRANSPORT
	bool "Nimble transport Support"
	default n

if BLE_NIMBLE_TRANSPORT
source external/nimble/transport/Kconfig
endif

menuconfig BLE_NIMBLE_OS
	bool "Nimble OS Support"
	default n

menuconfig BLE_NIMBLE_UTIL
	bool "Nimble UTIL Support"
	default n

menuconfig BLE_NIMBLE_HAL
	bool "Nimble HAL Support"
	default n
	
if BLE_NIMBLE_HAL
source external/nimble/hal/Kconfig
endif


endif # BLE_NIMBLE
```

## nuttx/external/nimble/hal/Kconfig
```kconfig
#
# For a description of the syntax of this configuration file,
# see the file kconfig-language.txt in the NuttX tools repository.
#

if BLE_NIMBLE_HAL

#Current nimble support hardware, could be extend in future.

# NRF52xxx
config BLE_NIMBLE_HAL_NRF52xxx
	bool "Nimble Support NORDIC NRF52xxx hardware."
	default n

endif # BLE_NIMBLE_HAL
```

## nuttx/external/nimble/host/Kconfig
```kconfig
#
# For a description of the syntax of this configuration file,
# see the file kconfig-language.txt in the NuttX tools repository.
#

if BLE_NIMBLE_HOST

#Current we support MESH only or BLE only

#1. ble host mesh support
config BLE_NIMBLE_HOST_MESH_SUPPORT
	bool "Nimble host mesh Support"
	default n

if BLE_NIMBLE_HOST_MESH_SUPPORT
	#source host/mesh/Kconfig
endif # BLE_NIMBLE_HOST_MESH_SUPPORT

endif # BLE_NIMBLE_HOST
```

## nuttx/external/nimble/transport/Kconfig
```kconfig
#
# For a description of the syntax of this configuration file,
# see the file kconfig-language.txt in the NuttX tools repository.
#

if BLE_NIMBLE_TRANSPORT

#Current nimble support 4 transport ways

#1. emspi support
config BLE_NIMBLE_TRANSPORT_SPI
	bool "Mynewt nimble transport with SPI interface Support"
	default n

if BLE_NIMBLE_TRANSPORT_SPI
	#source transport/emspi/Kconfig
endif # BLE_NIMBLE_TRANSPORT_SPI
################################################################################

#2. ram support
config BLE_NIMBLE_TRANSPORT_RAM
	bool "Mynewt nimble transport with RAM interface Support"
	default n

if BLE_NIMBLE_TRANSPORT_RAM
	#source transport/ram/Kconfig
endif # BLE_NIMBLE_TRANSPORT_RAM
################################################################################

#3. socket support
config BLE_NIMBLE_TRANSPORT_SOCKET
	bool "Mynewt nimble transport with socket interface Support"
	default n

if BLE_NIMBLE_TRANSPORT_SOCKET
	#source transport/socket/Kconfig
endif # BLE_NIMBLE_TRANSPORT_SOCKET
################################################################################

#4. uart support
config BLE_NIMBLE_TRANSPORT_UART
	bool "Mynewt nimble transport with UART interface Support"
	default n

if BLE_NIMBLE_TRANSPORT_UART
	#source transport/uart/Kconfig
endif # BLE_NIMBLE_TRANSPORT_UART
################################################################################


endif # BLE_NIMBLE_TRANSPORT
```

## nuttx/external/systemview/Kconfig
```kconfig
#
# For a description of the syntax of this configuration file,
# see the file kconfig-language.txt in the NuttX tools repository.
#

menuconfig SEGGER_SYSVIEW
	bool
	prompt "Segger SystemView Support"
	default n
	help
	  This option enables the SystemView library of Segger.
```

## nuttx/external/tinycrypt/Kconfig
```kconfig
#
# For a description of the syntax of this configuration file,
# see the file kconfig-language.txt in the NuttX tools repository.
#

menuconfig TINYCRYPT
	bool
	prompt "tinyCrypt Support"
	default n
	help
	  This option enables the tinyCrypt cryptography library.
```
