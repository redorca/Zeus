## apps/examples/nimble_uart/Kconfig
```kconfig
#
# For a description of the syntax of this configuration file,
# see the file kconfig-language.txt in the NuttX tools repository.
#

config EXAMPLES_NIMBLE_UART
	bool "Nimble uart example"
	default n
	---help---
		Enable the Nimble uart example

if EXAMPLES_NIMBLE_UART

config EXAMPLES_NIMBLE_UART_PROGNAME
	string "Program name"
	default "nimble uart"
	---help---
		This is the name of the program that will be use when the NIMBLE UART ELF
		program is installed.

endif
```

## apps/examples/nimble_voice/Kconfig
```kconfig
#
# For a description of the syntax of this configuration file,
# see the file kconfig-language.txt in the NuttX tools repository.
#

config EXAMPLES_NIMBLE_VOICE
	bool "Nimble voice example"
	default n
	---help---
		Enable the Nimble voice example

if EXAMPLES_NIMBLE_VOICE

config EXAMPLES_NIMBLE_VOICE_PROGNAME
	string "Program name"
	default "nimble voice"
	---help---
		This is the name of the program that will be use when the NIMBLE VOICE ELF
		program is installed.

endif
```

## apps/examples/qdecoder/Kconfig
```kconfig
#
# For a description of the syntax of this configuration file,
# see the file kconfig-language.txt in the NuttX tools repository.
#

config EXAMPLES_QDECODER
	bool "Quadrature decoder example"
	default n
	depends on QDECODER
	---help---
		Enable the quadrature decoder example

if EXAMPLES_QDECODER

config EXAMPLES_QDECODER_DEVPATH
	string "QE device path"
	default "/dev/qdec0"
	---help---
		The default path to the QD device

config EXAMPLES_QDECODER_NSAMPLES
	int "Number of samples"
	default 0
	depends on !NSH_BUILTIN_APPS
	---help---
		If CONFIG_NSH_BUILTIN_APPS is defined, then the number of
		samples is provided on the command line and this value is ignored.
		Otherwise, this number of samples is collected and the program
		terminates. If the value is 0, samples are collected indefinitely.

config EXAMPLES_QDECODER_DELAY
	int "Delay between samples"
	default 10
	---help---
		This value provides the delay (in seconds) before sample data .
		If CONFIG_NSH_BUILTIN_APPS is defined, then this value is the default
		delay if no other delay is provided on the command line.

endif
```

## apps/examples/rtc/Kconfig
```kconfig
#
# For a description of the syntax of this configuration file,
# see the file kconfig-language.txt in the NuttX tools repository.
#

config EXAMPLES_RTC
	bool "RTC example"
	default n
	depends on BUILD_FLAT
	---help---
		Enable the rtc example

if EXAMPLES_RTC

config EXAMPLE_COUNTER_DEVNAME
	string "RTC device name"
	default "/dev/rtc1"
	---help---
		This is the name of the timer device that will be tested.
endif
```

## apps/examples/stepcounting/Kconfig
```kconfig
#
# For a description of the syntax of this configuration file,
# see the file kconfig-language.txt in the NuttX tools repository.
#

config EXAMPLES_STEP
	bool "step counting"
	default n
	---help---
		step counting example based on accelerometer

if EXAMPLES_STEP

config EXAMPLES_ACCR_DEVPATH
	string "accelerometer device path"
	default "/dev/accel0"
	---help---
		The default path to the accelerometer device. Default: /dev/accel0


endif
```

## apps/examples/zeus_demo/Kconfig
```kconfig
#
# For a description of the syntax of this configuration file,
# see the file kconfig-language.txt in the NuttX tools repository.
#

menuconfig EXAMPLES_ZEUS_DEMO
	bool "ZEUS demo example"
	default n
	---help---


if EXAMPLES_ZEUS_DEMO

config EXAMPLES_ZEUS_DEMO_PROGNAME
	string "Program name"
	default "zeus demo"
	depends on BUILD_KERNEL
	---help---
		This is the name of zeus demo.

config EXAMPLES_DEMO_MAGNETIC
	bool
	prompt "Magnetic demo Support"
	default n
	---help---
	  This option enables the magnetic demo.

endif
```

## apps/system/tmp108/Kconfig
```kconfig
#
# For a description of the syntax of this configuration file,
# see the file kconfig-language.txt in the NuttX tools repository.
#

menuconfig SYSTEM_TMP108
	bool "Temperature"
	default n
	depends on TMP108_I2C
	---help---
		Enable support for the NSH temp command.  This command will read the
		current temperature from an LM-75 (or compatible) temperature sensor
		and show the temperature on stdout.

if SYSTEM_TMP108

config SYSTEM_TMP108_DEVNAME
	string "Temperature sensing device"
	default "/dev/temp0"

choice
	prompt "Temperature units"
	default SYSTEM_TMP108_FAHRENHEIT

config SYSTEM_TMP108_FAHRENHEIT
	bool "Fahrenheit"

config SYSTEM_TMP108_CELSIUS
	bool "Celsius"

endchoice

config SYSTEM_TMP108_STACKSIZE
	int "Stack size (bytes)"
	default 1024

config SYSTEM_TMP108_PRIORITY
	int "Command priority"
	default 100

endif
```

## apps/system/ymodem_receiver/Kconfig
```kconfig
#
# For a description of the syntax of this configuration file,
# see the file kconfig-language.txt in the NuttX tools repository.
#

config SYSTEM_YMODEM_RECEIVER
	bool "Ymodem receiver command"
	default n
	depends on YMODEM_RECEIVER
	---help---
		Enable support for ymodem receiver command line interface.

if SYSTEM_YMODEM_RECEIVER

config YMODEM_RECEIVER_MAX_MSG
	int "max message number"
	default 5
	---help---
		max message number in message queue.

config YMODEM_RECEIVER_MSG_SIZE
	int "message length"
	default 32
	---help---
		max message length per message.

config YMODEM_RECEIVER_SOURCE_DEVICE
	string "data source device"
	default "/dev/ttyS1"

config YMODEM_RECEIVER_DEFAULT_DEST_FILE
	string "default destination file"
	default "/media/ymodem"
	---help---
		we will write to this file if the user didn't specified it in start command

config YMODEM_RECEIVER_MSG_HANDLE_THREAD_STACK_SIZE
	int "message handler thread stack size"
	default 2048

config YMODEM_RECEIVER_BUF_NUM
	int "buffer number"
	default 4
	---help---
		number of buffers in the buffer queue

config YMODEM_RECEIVER_BUF_SIZE
	int "buffer length"
	default 1024
endif
```

## apps/system/zglue_fast/Kconfig
```kconfig
#
# For a description of the syntax of this configuration file,
# see the file kconfig-language.txt in the NuttX tools repository.
#

menuconfig SYSTEM_FAST_API_NSH
	bool "Zglue Smart fabric NSH commands tool"
	default n
	depends on NSH_BUILTIN_APPS && SYSTEM_FAST_DRIVER
	---help---
		Enable nsh support for the zglue smartfabric.

if SYSTEM_FAST_API_NSH

config SYSTEM_FAST_DEBUG_API_NSH
	bool "Enable Zglue Smart Fabric NSH Debug APIs"
	default n
	---help---
		Enables debug APIs supported by the Zglue smart fabric .
endif
```

## apps/utils/Kconfig
```kconfig
#
# For a description of the syntax of this configuration file,
# see misc/tools/kconfig-language.txt.
#

menu "Utils Library"

config EASY_TIMER
	bool "Easy timer feature support."
	default n
	---help---
		Create a easy timer for application.

config APP_TIMER
	bool "Application timer feature support"
	default n
	---help---
	       Create application timer

config YMODEM_RECEIVER
	bool "ymodem receiver slave"
	default n
	---help---
		create ymodem receiver

config ZGLUE_FAST_APP_API
	bool "zglue fast app api"
	default n
	---help---
		Enable zglue fast api for user.

config STEPCNT_ALGO
	bool "step counting algorithm"
	default n
	---help---
		step counting algorithm base on the accelerometer
endmenu
```

## apps/wireless/bluetooth/bt/Kconfig
```kconfig
#
# For a description of the syntax of this configuration file,
# see misc/tools/kconfig-language.txt.
#

# this config option is for bluetooth feature , please don't
# delete this file

config WIRELESS_BT
	bool "Bluetooth feature support"
	default n
	---help---
	bluetooth feature support option
```

## apps/wireless/bluetooth/libutils/Kconfig
```kconfig
#
# For a description of the syntax of this configuration file,
# see misc/tools/kconfig-language.txt.
#

if WIRELESS_BT

config BT_LIBUTILS
	bool "Common bluetooth library routines"
	default y
	---help---
		Some common library routines for bluetooth apps

config BT_MSG_Q_STACKSIZE
	int "Stack size(bytes) of message queue thread"
	default 1024

config BT_MSG_Q_MAX_MSG_NUMBER
	int "The max number of messages"
	default 32

config BT_MSG_Q_PRIORITY
	int "Message queue thread Priority"
	default 64

endif
	
```

## apps/wireless/bluetooth/nrf/Kconfig
```kconfig
#
# For a description of the syntax of this configuration file,
# see misc/tools/kconfig-language.txt.
#

# this module is only for nordic bluetooth
# so , it will depend on NRF52_BLUETOOTH

if WIRELESS_BT && NRF52_BLUETOOTH

config BT_NRF
	bool "NRF bluetooth feature"
	default y
	depends on NRF52_BLUETOOTH
	---help---
		NRF bluetooth feature

config BLE_APP_ADV_DEVICE_NAME
	string "App advertising device name"
	default "ZG_BLE_APP"

config BLE_APP_ADV_MANUFACTURER_NAME
	string "App advertising manufacturer name"
	default "ZGLUE"

config BLE_APP_ADV_INTERVAL
	int "Units of slot(625us)"
	default 100

config BLE_APP_ADV_TIMEOUT
	int "Units of seconds, 0 means no timeout"
	default 0

config BLE_APP_ADV_TYPE
	int "App advertising type"
	default 0

config BLE_APP_PPCP_MIN_INTERVAL
	int "Set peripheral preferred minimum connection interval"
	default 6

config BLE_APP_PPCP_MAX_INTERVAL
	int "Set peripheral preferred maximum connection interval"
	default 3200

config BLE_APP_PPCP_SLAVE_LATENCY
	int "Set peripheral preferred slave latency"
	default 0

config BLE_APP_CONN_SUP_TIMEOUT
	int "Set peripheral preferred connection timeout, default 3min"
	default 1800

endif
```
