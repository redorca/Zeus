## apps/CppUTest/Kconfig
```kconfig
#
# For a description of the syntax of this configuration file,
# see the file kconfig-language.txt in the NuttX tools repository.
#

config CPPUTEST_FRAMEWORK
  bool "cpp Unit Test Framework"
  default n
  depends on HAVE_CXX && UCLIBCXX
  ---help---
    This is the framework of cpp Unit Test
```

## apps/examples/AI/Kconfig
```kconfig
#
# For a description of the syntax of this configuration file,
# see the file kconfig-language.txt in the NuttX tools repository.
#

config EXAMPLES_AI
	bool "AI Demo example"
	default n
	depends on ICE40UP
	---help---
		Enable the AI demo example


choice
    prompt "motion detection sensor"
    default AI_MOTION_MC3672
    depends on EXAMPLES_AI

config AI_MOTION_MC3672
    bool "MC3672"

config AI_MOTION_LSM6DS3
    bool "LSM6DS3"

endchoice
```

## apps/examples/BQ2512x/Kconfig
```kconfig
#
# For a description of the syntax of this configuration file,
# see the file kconfig-language.txt in the NuttX tools repository.
#

config EXAMPLES_PMIC_BQ25120A
	bool "PMIC BQ25120a example"
	default n
	---help---
		Enable the PMIC BQ25120a example

if EXAMPLES_PMIC_BQ25120A

config EXAMPLES_BQ2512X_PROGNAME
	string "Program name"
	default "bq25120a"
	depends on BUILD_KERNEL
	---help---
		This is the name of the program that will be use when the NSH ELF
		program is installed.

config EXAMPLES_BQ25120A_PRIORITY
	int "BQ25120A task priority"
	default 100

config EXAMPLES_BQ25120A_STACKSIZE
	int "BQ25120A stack size"
	default 2048

endif
```

## apps/examples/ble_app_uart/Kconfig
```kconfig
#
# For a description of the syntax of this configuration file,
# see the file kconfig-language.txt in the NuttX tools repository.
#

config EXAMPLES_BLE_APP_UART
	bool "BLE app uart example"
	default n
	depends on NRF52_BLUETOOTH
	---help---
		Enable the BLE \"APP UART\" example


if EXAMPLES_BLE_APP_UART

config EXAMPLES_BLE_APP_UART_PROGNAME
	string "Program name"
	default "hello"
	depends on BUILD_KERNEL
	---help---
		This is the name of the program that will be use when the NSH ELF
		program is installed.

config EXAMPLES_BLE_APP_UART_PRIORITY
	int "Ble app uart task priority"
	default 100

config EXAMPLES_BLE_APP_UART_STACKSIZE
	int "Ble app uart stack size"
	default 2048

endif
```

## apps/examples/ble_dfu/Kconfig
```kconfig
#
# For a description of the syntax of this configuration file,
# see the file kconfig-language.txt in the NuttX tools repository.
#

config EXAMPLES_BLE_DFU
	bool "BLE DFU example"
	default n
	depends on NRF52_BLUETOOTH
	---help---
		Enable the BLE \"DFU!\" example

if EXAMPLES_BLE_DFU

config EXAMPLES_BLE_DFU_PROGNAME
	string "Program name"
	default "dfu"
	depends on BUILD_KERNEL
	---help---
		This is the name of the program that will be use when the NSH ELF
		program is installed.

config EXAMPLES_BLE_DFU_PRIORITY
	int "Dfu task priority"
	default 100

config EXAMPLES_BLE_DFU_STACKSIZE
	int "Dfu stack size"
	default 2048

endif
```

## apps/examples/ble_hello/Kconfig
```kconfig
#
# For a description of the syntax of this configuration file,
# see the file kconfig-language.txt in the NuttX tools repository.
#

config EXAMPLES_BLE_HELLO
	bool "BLE hello world example"
	default n
	depends on NRF52_BLUETOOTH
	---help---
		Enable the BLE \"Hello, World!\" example

if EXAMPLES_BLE_HELLO

config EXAMPLES_BLE_HELLO_PROGNAME
	string "Program name"
	default "hello"
	depends on BUILD_KERNEL
	---help---
		This is the name of the program that will be use when the NSH ELF
		program is installed.

config EXAMPLES_BLE_HELLO_PRIORITY
	int "Hello task priority"
	default 100

config EXAMPLES_BLE_HELLO_STACKSIZE
	int "Hello stack size"
	default 2048

endif
```

## apps/examples/blinky_zglue/Kconfig
```kconfig
#
# For a description of the syntax of this configuration file,
# see the file kconfig-language.txt in the NuttX tools repository.
#

config EXAMPLES_BLINKY_ZGLUE
	bool "Blinky zglue example"
	default n
    select SYSTEM_LIB_FASTAPI
	---help---
		Enable the NuttShell (NSH) example

if EXAMPLES_BLINKY_ZGLUE

config EXAMPLES_BLINKY_ZGLUE_PROGNAME
	string "Program name"
	default "blinky"
	depends on BUILD_KERNEL
	---help---
		This is the name of the program that will be use when the NSH ELF
		program is installed.

config EXAMPLES_BLINKY_ZGLUE_PRIORITY
	int "blinky task priority"
	default 100

config EXAMPLES_BLINKY_ZGLUE_STACKSIZE
	int "blinky stack size"
	default 2048

endif
```

## apps/examples/bmi160/Kconfig
```kconfig
#
# For a description of the syntax of this configuration file,
# see the file kconfig-language.txt in the NuttX tools repository.
#

config EXAMPLES_BMI160
	bool "bmi160 example"
	default n
	depends on BMI160 && LIB_BOARDCTL
	---help---
		Enable the bmi160 example

if EXAMPLES_BMI160

config EXAMPLES_BMI160_DEVPATH
	string "bmi160 device path"
	default "/dev/bmi160"
	---help---
		The default path to the bmi160 device. Default: /dev/bmi160

config EXAMPLES_BMI160_NSAMPLES
	int "Number of loops"
	default 0
	depends on !NSH_BUILTIN_APPS
	---help---
		If NSH_BUILTIN_APPS is defined, then the number of samples is provided
		on the command line and this value is ignored.  Otherwise, this number
		of samples is collected and the program terminates.  Default:  0 (samples
		are collected indefinitely).
endif
```

## apps/examples/bmm150/Kconfig
```kconfig
#
# For a description of the syntax of this configuration file,
# see the file kconfig-language.txt in the NuttX tools repository.
#

config EXAMPLES_BMM150
	bool "bmm150 example"
	default n
	depends on BMM150 && LIB_BOARDCTL
	---help---
		Enable the bmm150 example

if EXAMPLES_BMM150

config EXAMPLES_BMM150_DEVPATH
	string "bmm150 device path"
	default "/dev/mag0"
	---help---
		The default path to the bmm150 device. Default: /dev/mag0

config EXAMPLES_BMM150_NSAMPLES
	int "Number of loops"
	default 0
	depends on !NSH_BUILTIN_APPS
	---help---
		If NSH_BUILTIN_APPS is defined, then the number of samples is provided
		on the command line and this value is ignored.  Otherwise, this number
		of samples is collected and the program terminates.  Default:  0 (samples
		are collected indefinitely).
endif
```

## apps/examples/bootloader/Kconfig
```kconfig
#
# For a description of the syntax of this configuration file,
# see the file kconfig-language.txt in the NuttX tools repository.
#

config EXAMPLES_BOOTLOADER
	bool "\"bootloader by mcuboot\" nuttx example"
	default n
	---help---
		Enable the \"bootloader of mcuboot\" nuttx example

if EXAMPLES_BOOTLOADER

config EXAMPLES_BOOTLOADER_PROGNAME
	string "Program name"
	default "bootloader"
	depends on BUILD_KERNEL
	---help---
		This is the name of the program that will be use when the NSH ELF
		program is installed.

config EXAMPLES_BOOTLOADER_PRIORITY
	int "bootloader task priority"
	default 100

config EXAMPLES_BOOTLOADER_STACKSIZE
	int "bootloader stack size"
	default 2048

endif
```

## apps/examples/comp/Kconfig
```kconfig
#
# For a description of the syntax of this configuration file,
# see the file kconfig-language.txt in the NuttX tools repository.
#

config EXAMPLES_COMP
	bool "COMP example"
	default n
	depends on COMP && LIB_BOARDCTL
	---help---
		Enable the comp example

if EXAMPLES_COMP

config EXAMPLES_COMP_DEVPATH
	string "COMP device path"
	default "/dev/comp"
	---help---
		The default path to the comp device. Default: /dev/comp

config EXAMPLES_COMP_NSAMPLES
	int "Number of Sample Groups"
	default 0
	depends on !NSH_BUILTIN_APPS
	---help---
		If NSH_BUILTIN_APPS is defined, then the number of samples is provided
		on the command line and this value is ignored.  Otherwise, this number
		of samples is collected and the program terminates.  Default:  0 (samples
		are collected indefinitely).
endif
```

## apps/examples/cpput/Kconfig
```kconfig
#
# For a description of the syntax of this configuration file,
# see the file kconfig-language.txt in the NuttX tools repository.
#

config EXAMPLES_CPPUT
	bool "cpp Unit Test program Example"
	default n
	select UCLIBCXX
	select HAVE_CXX
	select CPPUTEST_FRAMEWORK
	---help---
		Enable the cpp Unit Test program
```

## apps/examples/iCE40UP/Kconfig
```kconfig
#
# For a description of the syntax of this configuration file,
# see the file kconfig-language.txt in the NuttX tools repository.
#

config EXAMPLES_ICE40UP
	bool "iCE40UP example"
	default n
	depends on ICE40UP
	---help---
		Enable the iCE40UP example
```

## apps/examples/lsm6ds3/Kconfig
```kconfig
#
# For a description of the syntax of this configuration file,
# see the file kconfig-language.txt in the NuttX tools repository.
#

config EXAMPLES_LSM6DS3
	bool "lsm6ds3 example"
	default n
	depends on LSM6DS3 && LIB_BOARDCTL
	---help---
		Enable the lsm6ds3 example

if EXAMPLES_LSM6DS3

config EXAMPLES_LSM6DS3_DEVPATH
	string "LSM6DS3 device path"
	default "/dev/lsm6ds3"
	---help---
		The default path to the lsm6ds3 device. Default: /dev/lsm6ds3

config EXAMPLES_LSM6DS3_NSAMPLES
	int "Number of loops"
	default 0
	depends on !NSH_BUILTIN_APPS
	---help---
		If NSH_BUILTIN_APPS is defined, then the number of samples is provided
		on the command line and this value is ignored.  Otherwise, this number
		of samples is collected and the program terminates.  Default:  0 (samples
		are collected indefinitely).
endif
```

## apps/examples/max86140/Kconfig
```kconfig
#
# For a description of the syntax of this configuration file,
# see the file kconfig-language.txt in the NuttX tools repository.
#

config EXAMPLES_MAX86140
	bool "max86140 example"
	default n
	depends on MAX86140
	---help---
		Enable the MAX86140 example

if EXAMPLES_MAX86140

config EXAMPLES_MAX86140_PROGNAME
	string "Program name"
	default "max86140"
	depends on BUILD_KERNEL
	---help---
		This is the name of the program that will be use when the NSH ELF
		program is installed.

config EXAMPLES_MAX86140_PRIORITY
	int "max86140 task priority"
	default 100

config EXAMPLES_MAX86140_STACKSIZE
	int "max86140 stack size"
	default 2048

endif
```

## apps/examples/mtdblockrw/Kconfig
```kconfig
#
# For a description of the syntax of this configuration file,
# see the file kconfig-language.txt in the NuttX tools repository.
#

config EXAMPLES_MTDBLOCKRW
	bool "MTD BLOCK R/W test"
	default n
	depends on MTD
	---help---
		Enable the MTD Block R/W test example.
```

## apps/examples/nimble/Kconfig
```kconfig
#
# For a description of the syntax of this configuration file,
# see the file kconfig-language.txt in the NuttX tools repository.
#

config EXAMPLES_NIMBLE
	bool "Nimble example"
	default n
	---help---
		Enable the Nimble example

if EXAMPLES_NIMBLE

config EXAMPLES_NIMBLE_PROGNAME
	string "Program name"
	default "nimble"
	---help---
		This is the name of the program that will be use when the NIMBLE ELF
		program is installed.

endif
```

## apps/examples/nimble_6lowpan/Kconfig
```kconfig
#
# For a description of the syntax of this configuration file,
# see the file kconfig-language.txt in the NuttX tools repository.
#

config EXAMPLES_NIMBLE_6LOWPAN
	bool "Nimble IPV6 for low power area network example"
	default n
	---help---
		Enable the Nimble 6lowpan example

if EXAMPLES_NIMBLE_6LOWPAN

config EXAMPLES_NIMBLE_6LOWPAN_PROGNAME
	string "Program name"
	default "nimble 6lowpan"
	---help---
		This is the name of the program that will be use when the NIMBLE 6LOWPAN ELF
		program is installed.

endif
```

## apps/examples/nimble_central/Kconfig
```kconfig
#
# For a description of the syntax of this configuration file,
# see the file kconfig-language.txt in the NuttX tools repository.
#

config EXAMPLES_NIMBLE_CENTRAL
	bool "Nimble central example"
	default n
	---help---
		Enable the Nimble central example

if EXAMPLES_NIMBLE_CENTRAL

config EXAMPLES_NIMBLE_CENTRAL_PROGNAME
	string "Program name"
	default "Nimble central"
	---help---
		This is the name of the program that will be use when the Nimble central ELF
		program is installed.

endif
```

## apps/examples/nimble_dfu/Kconfig
```kconfig
#
# For a description of the syntax of this configuration file,
# see the file kconfig-language.txt in the NuttX tools repository.
#

config EXAMPLES_NIMBLE_DFU
	bool "Nimble dfu example"
	default n
	---help---
		Enable the Nimble dfu example

if EXAMPLES_NIMBLE_DFU

config EXAMPLES_NIMBLE_DFU_PROGNAME
	string "Program name"
	default "nimble dfu"
	---help---
		This is the name of the program that will be use when the NIMBLE DFU ELF
		program is installed.

endif
```

## apps/examples/nimble_dfu_c/Kconfig
```kconfig
#
# For a description of the syntax of this configuration file,
# see the file kconfig-language.txt in the NuttX tools repository.
#

config EXAMPLES_NIMBLE_DFU_C
	bool "Nimble DFU_C example"
	default n
	---help---
		Enable the Nimble DFU_C example

if EXAMPLES_NIMBLE_DFU_C

config EXAMPLES_NIMBLE_DFU_C_PROGNAME
	string "Program name"
	default "Nimble DFU_C"
	---help---
		This is the name of the program that will be use when the Nimble DFU_C ELF
		program is installed.

endif
```

## apps/examples/nimble_mesh/Kconfig
```kconfig
#
# For a description of the syntax of this configuration file,
# see the file kconfig-language.txt in the NuttX tools repository.
#

config EXAMPLES_NIMBLE_MESH
	bool "Nimble mesh example"
	default n
	---help---
		Enable the Nimble mesh example

if EXAMPLES_NIMBLE_MESH

config EXAMPLES_NIMBLE_MESH_PROGNAME
	string "Program name"
	default "nimble mesh"
	---help---
		This is the name of the program that will be use when the NIMBLE MESH ELF
		program is installed.

endif
```

## apps/examples/nimble_nsh/Kconfig
```kconfig
#
# For a description of the syntax of this configuration file,
# see the file kconfig-language.txt in the NuttX tools repository.
#

config EXAMPLES_NIMBLE_NSH
	bool "Nimble nsh test example"
	default n
	---help---
		Enable the Nimble nsh test example

if EXAMPLES_NIMBLE_NSH


endif
```
